## boards/hyperx/alloy_rise_75/Kconfig.alloy_rise_75
```kconfig
config BOARD_ALLOY_RISE_75
	bool "HyperX Alloy Rise 75"
	select SOC_LPC55S16
	select SOC_PART_NUMBER_LPC55S16JBD100
```

## boards/hyperx/alloy_rise_75/Kconfig.defconfig
```kconfig
if BOARD_ALLOY_RISE_75
config BOARD
    default "alloy_rise_75"

config ZMK_KEYBOARD_NAME
    default "Hyperx Alloy Rise 75"


config ZMK_KSCAN_MATRIX_POLLING
    default y

endif #BOARD_ALLOY_RISE_75
```

## boards/hyperx/alloy_rise_75/alloy_rise_75_defconfig
```kconfig
CONFIG_GPIO=y
CONFIG_EC11=y
CONFIG_EC11_TRIGGER_GLOBAL_THREAD=y


CONFIG_NANOPB=y
CONFIG_HAS_CMSIS_CORE=y
```

## boards/hyperx/alloy_rise_75/board.yml
```yaml
board:
  name: alloy_rise_75
  vendor: hyperx
  socs:
    - name: lpc55s16
  revision:
    format: major.minor.patch
    default: 1.0.0
    revisions:
      - name: 1.0.0
```
